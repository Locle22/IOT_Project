#include <Arduino.h>
#include <Adafruit_NeoPixel.h>
#include "DHT20.h"
#include "neopixel_blinky.h"

#define PIN_NEOPIXEL 45
#define NUMPIXEL 1

const uint8_t neopixelDisplayHumidity[20][3]={
    {255, 0, 0},    {255, 50, 0},   {255, 100, 0},   {255, 150, 0},   
    {255, 200, 0},  {255, 255, 0},  {200, 255, 0},   {150, 255, 0},   
    {100, 255, 0},  {0, 255, 0},    {0, 255, 100},   {0, 255, 200},   
    {0, 255, 255},  {0, 200, 255},  {0, 150, 255},   {0, 100, 255},  
    {0, 0, 255},    {100, 0, 255},  {150, 0, 255},   {255, 0, 255}    
};

// ================= TASK ĐỌC CẢM BIẾN =================
void sensorRead(void *pvParameters){
    SensorData* data = (SensorData*) pvParameters;
    
    if(xSemaphoreTake(data->mutexData, portMAX_DELAY) == pdTRUE){
        data->dht20->begin();
        xSemaphoreGive(data->mutexData);
    }

    while(1) {
        double humidity = 0;
        
        if(xSemaphoreTake(data->mutexData, portMAX_DELAY) == pdTRUE){
            data->dht20->read();
            humidity = data->dht20->getHumidity();
            xSemaphoreGive(data->mutexData);
        }

        int level = (int)(humidity / 5.0);
        if(level < 0) level = 0;
        if(level >= 20) level = 19;

        if(xSemaphoreTake(data->mutexData, portMAX_DELAY) == pdTRUE){
            if (data->humiRange != level) {
                data->humiRange = level;
                xSemaphoreGive(data->semaNeoPixelUpdate); 
            }
            xSemaphoreGive(data->mutexData);
        }

        Serial.printf("Humidity: %.2f%% -> Level: %d\n", humidity, level);
        vTaskDelay(pdMS_TO_TICKS(2000)); // Cứ 2 giây đọc cảm biến 1 lần
    }
}

void neo_blinky(void *pvParameters){
    SensorData* data = (SensorData*) pvParameters;
    
    // Khởi tạo giống hệt code test thành công của bạn
    Adafruit_NeoPixel strip(NUMPIXEL, PIN_NEOPIXEL, NEO_GRB + NEO_KHZ800);
    strip.begin();
    strip.setBrightness(100); 
    strip.clear();
    strip.show();

    uint8_t current_r = neopixelDisplayHumidity[0][0];
    uint8_t current_g = neopixelDisplayHumidity[0][1];
    uint8_t current_b = neopixelDisplayHumidity[0][2];

    while(1) {
        if(xSemaphoreTake(data->semaNeoPixelUpdate, 0) == pdTRUE){
            if(xSemaphoreTake(data->mutexData, portMAX_DELAY) == pdTRUE){
                uint8_t level = data->humiRange;
                current_r = neopixelDisplayHumidity[level][0];
                current_g = neopixelDisplayHumidity[level][1];
                current_b = neopixelDisplayHumidity[level][2];
                xSemaphoreGive(data->mutexData);
            }
        }

        strip.setPixelColor(0, strip.Color(current_r, current_g, current_b));
        strip.show();
        vTaskDelay(pdMS_TO_TICKS(500));
        
        strip.setPixelColor(0, strip.Color(0, 0, 0));
        strip.show();
        vTaskDelay(pdMS_TO_TICKS(500));
    }
}